## conf/layer.conf
```bitbake
# We have a conf and classes directory, add to BBPATH
BBPATH .= ":${LAYERDIR}"

# We have recipes-* directories, add to BBFILES
BBFILES += "${LAYERDIR}/recipes-*/*/*.bb \
	${LAYERDIR}/recipes-*/*/*.bbappend"

BBFILE_COLLECTIONS += "pcbd-trenz-linux"
BBFILE_PATTERN_pcbd-trenz-linux = "^${LAYERDIR}/"
BBFILE_PRIORITY_pcbd-trenz-linux = "6"
```
